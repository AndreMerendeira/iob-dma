// SPDX-License-Identifier: (GPL-2.0 OR MIT)
/* Copyright (c) 2024 IObundle */

/dts-v1/;

/ {
    #address-cells = <1>;
    #size-cells = <1>;
    model = "IOb-SoC, VexRiscv";
    compatible = "IOb-SoC, VexRiscv";
    // CPU
    // Memory
    // Choosen
    soc {
        #address-cells = <1>;
        #size-cells = <1>;
        compatible = "iobundle,iob-soc", "simple-bus";
        ranges;

        // Other SOC peripherals go here

        // Add these Nodes to the device tree
        DMA0: dma@/*DMA0_ADDR_MACRO*/ {
            compatible = "iobundle,dma0";
            reg = <0x/*DMA0_ADDR_MACRO*/ 0x10>;
        };

    };
};
